## conf/layer.conf
```bitbake
BBPATH .= ":${LAYERDIR}"

BBFILES += "${LAYERDIR}/recipes-*/*/*.bb \
         ${LAYERDIR}/recipes-*/*/*.bbappend"

BBFILE_COLLECTIONS += "fetchai"
BBFILE_PATTERN_fetchai = "^${LAYERDIR}/"
BBFILE_PRIORITY_fetchai = "5"
LAYERVERSION_fetchai = "1"
```
